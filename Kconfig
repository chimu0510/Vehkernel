## Kconfig
```kconfig
# SPDX-License-Identifier: GPL-3.0-or-later
# Build-time configuration (ADR-0017): Kconfig decides what the firmware
# contains; parameters decide what is enabled after boot. Layers are merged in
# order: SoC (or SITL) defaults, board defaults, debug overlay.
mainmenu "Vehkernel configuration"

# Hardware facts. The board generator emits a fragment that turns on the ones
# a board has; they are declared here so options can depend on them on every
# platform, including SITL.
config BOARD_HAS_CAN
	bool

config BOARD_HAS_FLASH_PARAMS
	bool

config BOARD_HAS_ICM20948
	bool

config BOARD_IMU_BUS_SOFT_I2C
	bool

config BOARD_HAS_LINK_PORT
	bool

config BOARD_HAS_ACTUATORS
	bool

config BOARD_HAS_REVISION_ID
	bool

config BOARD_HAS_ACTUATOR_POWER_SENSE
	bool

config BOARD_HAS_DISPLAY
	bool

config BOARD_HAS_SSD1306
	bool

config BOARD_HAS_USER_KEY
	bool

# The board's bootloader (ADR-0023): exactly one is set for a board with a
# Flash layout.
config BOARD_BOOTLOADER_VEHKERNEL
	bool

config BOARD_BOOTLOADER_ARDUPILOT
	bool

config BOARD_BOOTLOADER_PX4
	bool

source "$(VK_BOARD_KCONFIG)"

choice PLATFORM
	prompt "Platform"

config PLATFORM_STM32F4
	bool "STM32F4"

config PLATFORM_SITL
	bool "SITL on the development host"

endchoice

menu "Vehicle models"

config VEHICLE_MODEL_WHEELED
	bool "WHEELED (differential, skid-steer, mecanum, omni)"
	default y

config VEHICLE_MODEL_ACKERMANN
	bool "ACKERMANN"

config VEHICLE_MODEL_THRUSTER
	bool "THRUSTER"

endmenu

menu "Estimators"

config ESTIMATOR_MAHONY
	bool "Mahony attitude estimator"
	depends on DRIVER_ICM20948
	default y
	select MATH_QUATERNION
	help
	  Attitude from the IMU with the Mahony complementary filter
	  (ADR-0014), published on vehicle_attitude.

config ESTIMATOR_LOCAL_ODOMETRY
	bool "Local odometry"
	depends on ESTIMATOR_MAHONY && ACTUATOR_CONTROL
	default y
	help
	  Dead reckoning from the vehicle model's body velocity measurement
	  with the attitude estimator's heading (ADR-0014), published on
	  vehicle_local_odometry.

endmenu

menu "Actuators"

config ACTUATOR_CONTROL
	bool "Actuator control"
	depends on BOARD_HAS_ACTUATORS || PLATFORM_SITL
	default y if PLATFORM_SITL
	help
	  A wheel speed PI per motor output on its encoder, driving PWM and
	  direction lines (ADR-0013), with direct-actuator setpoints over a
	  Link (spec 0006). On by default in SITL only: a board turns it on in
	  its defconfig once its platform implements the PWM output and
	  quadrature encoder contracts.

config CONTROL_CHAIN
	bool "Control chain"
	depends on ACTUATOR_CONTROL
	default y
	help
	  The control chain above actuator control (ADR-0013): body velocity
	  setpoints over a Link, allocated by the vehicle model selected at
	  boot to a wheel speed target per output (spec 0009).

config BRINGUP_MOTORS
	bool "Motor-to-encoder bring-up case"
	depends on ACTUATOR_CONTROL
	default y
	help
	  The bring-up case of ADR-0018 that pulses each motor open loop in
	  test mode and reports which encoder moved and in which direction,
	  started over a Link with bringup_run (spec 0006).

endmenu

menu "Local interface"

config LOCAL_DISPLAY
	bool "Local display"
	depends on DRIVER_SSD1306 && (BOARD_HAS_DISPLAY || PLATFORM_SITL)
	default y if PLATFORM_SITL
	select MATH_QUATERNION
	help
	  Shows the vehicle's status, attitude and Links on the board's
	  display, from a work item on wq:slow at most five times a second
	  (ADR-0022). On by default in SITL only: a board turns it on in its
	  defconfig once its platform implements the display bus.

config LOCAL_MENU
	bool "Local menu on the user key"
	depends on LOCAL_DISPLAY && (BOARD_HAS_USER_KEY || PLATFORM_SITL)
	default y if PLATFORM_SITL
	help
	  The user key switches the local display's pages and, while
	  disarmed, opens a menu that changes the menu parameters (ADR-0022).
	  Arming is refused while the menu is open. Without it the commander
	  never sees the menu open.

endmenu

menu "Drivers"

config DRIVER_CAN
	bool "CAN bus"
	depends on BOARD_HAS_CAN

config DRIVER_ICM20948
	bool "ICM20948 IMU"
	depends on BOARD_HAS_ICM20948 || PLATFORM_SITL
	default y
	help
	  TDK InvenSense ICM20948 accelerometer and gyroscope on I2C; the
	  magnetometer inside it is not used yet.

config DRIVER_SSD1306
	bool "SSD1306 display"
	depends on BOARD_HAS_SSD1306 || PLATFORM_SITL
	default y if PLATFORM_SITL
	help
	  Solomon Systech SSD1306 128 x 64 OLED controller on a write-only
	  display bus (ADR-0022).

config SOFT_I2C
	bool "Software I2C on two GPIO pins"
	depends on BOARD_IMU_BUS_SOFT_I2C || PLATFORM_SITL
	default y
	help
	  Bit-banged I2C with open-drain lines, for board devices wired to
	  pins hardware I2C cannot use (ADR-0015).

endmenu

menu "Storage"

config PARAM_STORAGE_FLASH
	bool "Parameters in internal Flash"
	depends on BOARD_HAS_FLASH_PARAMS || PLATFORM_SITL
	default y
	help
	  Non-default parameter values are stored entry by entry in two
	  alternating Flash sectors and survive power loss (ADR-0012,
	  ADR-0020). SITL keeps them in a simulated NOR Flash, in memory or
	  in the file given with --param-file. Without it, parameters live in
	  RAM and start from their defaults at every boot.

endmenu

menu "Links"

config LINK
	bool "Links with the custom protocol"
	default y
	help
	  The custom protocol of ADR-0002: COBS and CRC16 framing, handshake
	  with schema hashes, time synchronization, and parameter access
	  (ADR-0012).

config LINK_SERIAL
	bool "Links on the board serial ports"
	depends on LINK && PLATFORM_STM32F4 && BOARD_HAS_LINK_PORT
	default y
	help
	  A Link on each board serial port whose function is LINK: SERIAL1
	  (the Type-C port) and SERIAL2 (the one-key download port) on the
	  C50C V1.1, 8N1 at their SERIALn_BAUD parameters, 921600 by default
	  on that board. UART transmit and receive use DMA.

config LINK_UDP
	bool "Link over UDP"
	depends on LINK && PLATFORM_SITL
	default y
	help
	  SITL's default Link transport (ADR-0018). The address and port are
	  chosen on the command line, 127.0.0.1:15600 by default.

config LINK_PTY
	bool "Link over a pseudo-terminal"
	depends on LINK && PLATFORM_SITL
	default y
	help
	  An optional SITL Link transport, chosen with --link pty, for
	  testing tools against a real serial API without hardware
	  (ADR-0018).

endmenu

menu "Testing"

config BRINGUP_TESTS
	bool "Bring-up test build (replaces the application)"
	depends on PLATFORM_STM32F4 && SOFT_I2C && BOARD_HAS_ICM20948
	help
	  Builds a firmware that runs the L4 bring-up cases at boot, writes
	  the results to a RAM block for the bring-up runner to read over SWD,
	  then idles (ADR-0018). It never configures actuator outputs.

choice FAULT_TEST
	prompt "Fault test (hardware check only)"
	default FAULT_TEST_NONE
	help
	  For the hardware check of the fault stop and the hardware watchdog
	  (ADR-0005), set in a local debug overlay and never committed: once
	  an actuator output has been driven for 0.5 s, wq:ctrl faults or
	  stalls. SITL raises its faults with --fault instead.

config FAULT_TEST_NONE
	bool "None"

config FAULT_TEST_ASSERT
	bool "A failed configASSERT"
	depends on PLATFORM_STM32F4 && ACTUATOR_CONTROL

config FAULT_TEST_USAGE_FAULT
	bool "A UsageFault (an undefined instruction)"
	depends on PLATFORM_STM32F4 && ACTUATOR_CONTROL

config FAULT_TEST_STALL
	bool "wq:ctrl stalls with interrupts enabled"
	depends on PLATFORM_STM32F4 && ACTUATOR_CONTROL
	help
	  The output watchdog turns the outputs off, then the hardware
	  watchdog resets the board.

endchoice

endmenu

# Helper libraries. Only these may be pulled in with select.
config MATH_QUATERNION
	bool
```
